## drivers/led_strip/Kconfig
```kconfig
# Copyright (c) 2024 Kuba Birecki
# SPDX-License-Identifier: MIT

menuconfig LED_STRIP_IS31FL3743A
	bool "IS31FL3743A LED Matrix Driver"
	default y
	depends on GPIO
	depends on I2C
	depends on LED_STRIP
	help
        Enable an IS31FL3743A LED matrix driver.

            The IS31FL3743A is a general purpose 18xn(n=1-11) LED matrix
            programmed via 1MHz I2C compatible interface. Each LED can be
            dimmed individually with 8-bit PWM data and 8-bit DC scaling data
            which allows 256 steps of linear PWM dimming and 256 steps of DC
            current adjustable levels.
```
